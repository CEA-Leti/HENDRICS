## embedded-device/buildroot-external/Config.in
```kconfig
source "$BR2_EXTERNAL_EDEVICE_PATH/package/python-flask-redis/Config.in"
source "$BR2_EXTERNAL_EDEVICE_PATH/package/python-flask-socketio/Config.in"
```

## embedded-device/buildroot-external/configs/edevice_stm32mp1_defconfig
```kconfig
# Copyright (C) 2025 CEA - All Rights Reserved
# 
# This program is free software: you can redistribute it and/or modify it under
# the terms of the GNU General Public License as published by the Free Software
# Foundation, either version 3 of the License, or (at your option) any later
# version.
# 
# This program is distributed in the hope that it will be useful, but WITHOUT ANY
# WARRANTY; without even the implied warranty of  MERCHANTABILITY or FITNESS FOR
# A PARTICULAR PURPOSE. See the GNU General Public License for more details.
# 
# You should have received a copy of the GNU General Public License along with
# this program.  If not, see <http://www.gnu.org/licenses/>.

# ===
#  eDevice image, STMicroelectronic STM32MP1 configuration
# ===
BR2_arm=y
BR2_cortex_a7=y


# Linux headers same as kernel, a 6.1 series
BR2_PACKAGE_HOST_LINUX_HEADERS_CUSTOM_6_1=y

# Kernel
BR2_LINUX_KERNEL=y
BR2_LINUX_KERNEL_CUSTOM_GIT=y
BR2_LINUX_KERNEL_CUSTOM_REPO_URL="https://git.kernel.org/pub/scm/linux/kernel/git/cip/linux-cip.git"  
BR2_LINUX_KERNEL_CUSTOM_REPO_VERSION="v6.1.141-rt52" # Patched kernel version to support Real-Time (RT) functionality
# BR2_GLOBAL_PATCH_DIR="$(BR2_EXTERNAL_EDEVICE_PATH)/board/stm32mp1/patches/"

BR2_LINUX_KERNEL_USE_CUSTOM_CONFIG=y
BR2_LINUX_KERNEL_CUSTOM_CONFIG_FILE="$(BR2_EXTERNAL_EDEVICE_PATH)/linux.config" 

BR2_LINUX_KERNEL_DTS_SUPPORT=y
BR2_LINUX_KERNEL_CUSTOM_DTS_PATH="$(BR2_EXTERNAL_EDEVICE_PATH)/dts/stm32mp157c-dk2.dts"
BR2_LINUX_KERNEL_INTREE_DTS_NAME="stm32mp157c-dk2"
BR2_LINUX_KERNEL_INSTALL_TARGET=y
BR2_LINUX_KERNEL_NEEDS_HOST_PAHOLE=y
#BR2_LINUX_KERNEL_VMLINUX=y

# Filesystem
BR2_TARGET_ROOTFS_EXT2=y
BR2_TARGET_ROOTFS_EXT2_4=y
BR2_TARGET_ROOTFS_EXT2_SIZE="2G"
BR2_ROOTFS_POST_IMAGE_SCRIPT="board/stmicroelectronics/common/stm32mp157/post-image.sh"
BR2_ROOTFS_OVERLAY="$(BR2_EXTERNAL_EDEVICE_PATH)/board/stm32mp1/rootfs_overlay"
# BR2_TARGET_ROOTFS_TAR is not set

# Bootloaders
BR2_TARGET_ARM_TRUSTED_FIRMWARE=y
BR2_TARGET_ARM_TRUSTED_FIRMWARE_CUSTOM_VERSION=y
BR2_TARGET_ARM_TRUSTED_FIRMWARE_CUSTOM_VERSION_VALUE="v2.5"
BR2_TARGET_ARM_TRUSTED_FIRMWARE_PLATFORM="stm32mp1"
BR2_TARGET_ARM_TRUSTED_FIRMWARE_ADDITIONAL_VARIABLES="STM32MP_SDMMC=1 AARCH32_SP=sp_min DTB_FILE_NAME=stm32mp157c-dk2.dtb"
BR2_TARGET_ARM_TRUSTED_FIRMWARE_IMAGES="*.stm32"
BR2_TARGET_ARM_TRUSTED_FIRMWARE_NEEDS_DTC=y
BR2_TARGET_UBOOT=y
BR2_TARGET_UBOOT_BUILD_SYSTEM_KCONFIG=y
BR2_TARGET_UBOOT_CUSTOM_VERSION=y
BR2_TARGET_UBOOT_CUSTOM_VERSION_VALUE="2021.10"
BR2_TARGET_UBOOT_BOARD_DEFCONFIG="stm32mp15_trusted"

# BR2_TARGET_UBOOT_FORMAT_BIN is not set
BR2_TARGET_UBOOT_FORMAT_STM32=y
BR2_TARGET_UBOOT_NEEDS_OPENSSL=y
BR2_TARGET_UBOOT_CUSTOM_MAKEOPTS="DEVICE_TREE=stm32mp157c-dk2"

# Additional tools
BR2_PACKAGE_HOST_DOSFSTOOLS=y
BR2_PACKAGE_HOST_GENIMAGE=y
BR2_PACKAGE_HOST_MTOOLS=y
BR2_PACKAGE_TCPDUMP=y



## ===
## Start of Customization
## ===

BR2_INIT_SYSTEMD=y
# TTY on ALT+F2 (Can be disabled on prod)
BR2_PACKAGE_SYSTEMD_LOGIND=y # TTY on ALT+F2 (Can be disabled on prod)
BR2_ENABLE_LOCALE_WHITELIST="C en_US fr_FR"
BR2_GENERATE_LOCALE="en_US.UTF-8"
# Enable loadkeys command (Can be disabled on prod)
BR2_PACKAGE_KBD=y

# Setup timezone
BR2_TARGET_TZ_INFO=y
BR2_TARGET_TZ_ZONELIST="default"
BR2_TARGET_LOCALTIME="Europe/Paris"
BR2_PACKAGE_SYSTEMD_TIMESYNCD=n
BR2_PACKAGE_SYSTEMD_TIMEDATED=n
BR2_PACKAGE_NTP=y # Enable NTP for network time synchronization

# System configuration
BR2_TARGET_GENERIC_HOSTNAME="cea-edevice"
BR2_TARGET_GENERIC_ISSUE="Welcome to CEA's eDevice image!"

# required for nmap - toolchain C++
BR2_TOOLCHAIN_BUILDROOT_CXX=y 

# Packages
BR2_PACKAGE_DROPBEAR_CLIENT=y 
BR2_PACKAGE_DROPBEAR=y
BR2_PACKAGE_LIBTOMCRYP=y 
BR2_PACKAGE_LIBTOMMATH=y    
BR2_PACKAGE_CA_CERTIFICATES=y
BR2_PACKAGE_BASH=y
BR2_PACKAGE_VIM=y
BR2_PACKAGE_NMAP=y
BR2_PACKAGE_HTOP=y
BR2_PACKAGE_DCRON=y
BR2_PACKAGE_MINICOM=y
BR2_PACKAGE_SQLITE=y
BR2_PACKAGE_UDISKS=y
BR2_PACKAGE_PYTHON3=y
BR2_PACKAGE_PYTHON_PAHO_MQTT=y
BR2_PACKAGE_PYTHON3_SQLITE=y
BR2_PACKAGE_PYTHON_NUMPY=y
BR2_PACKAGE_PYTHON_FLASK=y
BR2_PACKAGE_REDIS=y
BR2_PACKAGE_PYTHON_REDIS=y
BR2_PACKAGE_PYTHON_SOCKETIO=y
BR2_PACKAGE_PYTHON_PYMODBUS=y
BR2_PACKAGE_PYTHON_TOML=y
BR2_PACKAGE_BUSYBOX_CONFIG="$(BR2_EXTERNAL_EDEVICE_PATH)/package/busybox/busybox.config"
BR2_PACKAGE_PURE_FTPD=y
BR2_PACKAGE_LIBBPF=y


# lsblk, etc
BR2_PACKAGE_UTIL_LINUX=y
BR2_PACKAGE_UTIL_LINUX_BINARIES=y
BR2_PACKAGE_ZSH=y
BR2_PACKAGE_TMUX=y
BR2_PACKAGE_CCRYPT=y
BR2_PACKAGE_SCREEN=y
BR2_PACKAGE_DBUS_GLIB=y
BR2_PACKAGE_LVM2=y
BR2_PACKAGE_PARTED=y
BR2_PACKAGE_SG3_UTILS=y

# users, passwds
BR2_TARGET_GENERIC_ROOT_PASSWD="root"

BR2_PACKAGE_MOSQUITTO=y
BR2_PACKAGE_POSTGRESQL=y
BR2_PACKAGE_IPTABLES=y
BR2_PACKAGE_HOST_PAHOLE=y
BR2_PACKAGE_LIBPCAP=y
BR2_PACKAGE_LIBPTHREAD_STUBS=y
BR2_PACKAGE_STRACE=y

#packages not avalaible in buildroot added via edevice app
BR2_PACKAGE_PYTHON_FLASK_REDIS=y
BR2_PACKAGE_PYTHON_FLASK_SOCKETIO=y
```

## embedded-device/buildroot-external/package/python-flask-redis/Config.in
```kconfig
menu "python-flask-redis"  

config BR2_PACKAGE_PYTHON_FLASK_REDIS
	bool "python-flask-redis"
	help
	  A nice way to use Redis in your Flask app.
endmenu
```

## embedded-device/buildroot-external/package/python-flask-socketio/Config.in
```kconfig
menu "python-flask-socketio"  

config BR2_PACKAGE_PYTHON_FLASK_SOCKETIO
	bool "python-flask-socketio"
	help
	  A nice way to use Redis in your Flask app.
endmenu
```
